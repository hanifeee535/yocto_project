## 14-main/build/conf/bblayers.conf
```bitbake
# POKY_BBLAYERS_CONF_VERSION is increased each time build/conf/bblayers.conf
# changes incompatibly
POKY_BBLAYERS_CONF_VERSION = "2"

BBPATH = "${TOPDIR}"
BBFILES ?= ""

BBLAYERS ?= " \
  /home/student/Desktop/ELD/14/poky/meta \
  /home/student/Desktop/ELD/14/poky/meta-poky \
  /home/student/Desktop/ELD/14/poky/meta-yocto-bsp \
  /home/student/Desktop/ELD/14/meta-xilinx/meta-xilinx-bsp \
  /home/student/Desktop/ELD/14/meta-xilinx/meta-xilinx-contrib \
  /home/student/Desktop/ELD/14/meta-pynq \
  /home/student/Desktop/ELD/14/meta-group14 \
  /home/student/Desktop/ELD/14/meta-compce460 \
  "
```

## 14-main/meta-compce460/conf/layer.conf
```bitbake
# We have a conf and classes directory, add to BBPATH
BBPATH .= ":${LAYERDIR}"

# We have recipes-* directories, add to BBFILES
BBFILES += "${LAYERDIR}/recipes-*/*/*.bb \
            ${LAYERDIR}/recipes-*/*/*.bbappend"

BBFILE_COLLECTIONS += "meta-compce460"
BBFILE_PATTERN_meta-compce460 = "^${LAYERDIR}/"
BBFILE_PRIORITY_meta-compce460 = "6"
LAYERDEPENDS_meta-compce460 = "pynq"
```

## 14-main/meta-group14/conf/layer.conf
```bitbake
# We have a conf and classes directory, add to BBPATH
BBPATH .= ":${LAYERDIR}"

# We have recipes-* directories, add to BBFILES
BBFILES += "${LAYERDIR}/recipes-*/*/*.bb \
            ${LAYERDIR}/recipes-*/*/*.bbappend"

BBFILE_COLLECTIONS += "../meta-group14"
BBFILE_PATTERN_../meta-group14 = "^${LAYERDIR}/"
BBFILE_PRIORITY_../meta-group14 = "6"
```
